## linux/arch/myemulator2/Kconfig
```kconfig
# SPDX-License-Identifier: GPL-2.0
config MYEMULATOR2
	def_bool y
	select ARCH_32BIT_OFF_T
	select GENERIC_ATOMIC64
	select GENERIC_CLOCKEVENTS
	select GENERIC_CLOCKSOURCE
	select GENERIC_IRQ_SHOW
	select HAVE_ARCH_TRACEHOOK
	select MODULES_USE_ELF_RELA
	select SERIAL_CORE
	select SERIAL_CORE_CONSOLE

config MMU
	def_bool y

config MYEMU2_BLOCK
	bool "MyEmulator2 virtual block device"
	default y
	depends on BLOCK

config FPU
	def_bool n

config NR_CPUS
	int
	default 1

source "kernel/Kconfig.hz"

config CMDLINE_BOOL
	bool "Default kernel command string"
	default y

config CMDLINE
	string "Default kernel command string"
	default "console=ttyMY0,115200 earlycon=myemulator2,0xf0000000 rdinit=/init"
	depends on CMDLINE_BOOL

config CMDLINE_FORCE
	bool "Force default kernel command string"
	default y
	depends on CMDLINE_BOOL
```

## linux/arch/myemulator2/configs/myemulator2_network_defconfig
```kconfig
CONFIG_MYEMULATOR2=y
CONFIG_64BIT=n
CONFIG_SMP=n
CONFIG_PREEMPT_NONE=y
CONFIG_EXPERT=y
CONFIG_HZ_100=y
CONFIG_BLK_DEV_INITRD=y
CONFIG_BLOCK=y
CONFIG_MYEMU2_BLOCK=y
CONFIG_INITRAMFS_SOURCE=""
CONFIG_BINFMT_ELF=y
CONFIG_SERIAL_8250=n
CONFIG_TTY=y
CONFIG_DEVTMPFS=y
CONFIG_DEVTMPFS_MOUNT=y
CONFIG_TMPFS=y
CONFIG_PROC_FS=y
CONFIG_SYSFS=y
CONFIG_NET=y
CONFIG_PACKET=y
CONFIG_UNIX=y
CONFIG_INET=y
CONFIG_IP_PNP=y
CONFIG_IP_PNP_DHCP=y
CONFIG_NETDEVICES=y
CONFIG_ETHERNET=y
CONFIG_VIRTIO=y
CONFIG_VIRTIO_MMIO=y
CONFIG_VIRTIO_NET=y
CONFIG_PRINTK=y
CONFIG_EARLY_PRINTK=y
CONFIG_PRINTK_TIME=y
CONFIG_DEFAULT_HOSTNAME="REM"
CONFIG_CMDLINE_BOOL=y
CONFIG_CMDLINE="console=myemu0,115200 earlycon=myemu32,0xf0000000 rdinit=/init virtio_mmio.device=0x200@0xf0200000:5 ip=dhcp"
CONFIG_CMDLINE_FORCE=y
CONFIG_DEBUG_INFO=n
CONFIG_DEBUG_KERNEL=n
# CONFIG_KALLSYMS is not set
CONFIG_MODULES=n
CONFIG_SOUND=n
CONFIG_USB=n
# CONFIG_BLOCK is not set
# CONFIG_INPUT is not set
# CONFIG_VT is not set
# CONFIG_HID is not set
# CONFIG_FW_LOADER is not set
# CONFIG_HW_RANDOM is not set
```

## linux/arch/myemulator2/configs/rem_0_1_defconfig
```kconfig
# REM 0.1 release baseline: console, ext4 userspace, and QEMU virtio-mmio NIC.
CONFIG_MYEMULATOR2=y
CONFIG_64BIT=n
CONFIG_SMP=n
CONFIG_PREEMPT_NONE=y
CONFIG_EXPERT=y
CONFIG_HZ_100=y
CONFIG_COMPACTION=n
CONFIG_BLK_DEV_INITRD=y
CONFIG_BLOCK=y
CONFIG_MYEMU2_BLOCK=y
CONFIG_INITRAMFS_SOURCE=""
CONFIG_BINFMT_ELF=y
CONFIG_SERIAL_8250=n
CONFIG_TTY=y
CONFIG_UNIX98_PTYS=y
CONFIG_LEGACY_PTYS=n
CONFIG_DEVTMPFS=y
CONFIG_DEVTMPFS_MOUNT=y
CONFIG_TMPFS=y
CONFIG_PROC_FS=y
CONFIG_SYSFS=y
CONFIG_PRINTK=y
CONFIG_EARLY_PRINTK=y
CONFIG_PRINTK_TIME=y
CONFIG_DEFAULT_HOSTNAME="myemulator2"
CONFIG_CMDLINE_BOOL=y
CONFIG_CMDLINE="console=ttyMY0,115200 earlycon=myemulator2,0xf0000000 root=/dev/myemu0 rw init=/sbin/init ip=off"
CONFIG_CMDLINE_FORCE=y
CONFIG_MODULES=n

# QEMU user-mode networking through the REM virtio-mmio machine model.
CONFIG_NET=y
CONFIG_INET=y
CONFIG_NETDEVICES=y
CONFIG_NET_CORE=y
CONFIG_ETHERNET=y
CONFIG_VIRTIO=y
CONFIG_VIRTIO_MMIO=y
CONFIG_VIRTIO_MMIO_CMDLINE_DEVICES=y
CONFIG_VIRTIO_NET=y

CONFIG_SOUND=n
CONFIG_USB=n
CONFIG_INPUT=n
CONFIG_VT=n
CONFIG_HID=n
CONFIG_FW_LOADER=n
CONFIG_HW_RANDOM=n
```
